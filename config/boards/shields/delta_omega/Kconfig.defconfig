## config/boards/shields/delta_omega/Kconfig.defconfig
```kconfig
if SHIELD_DELTA_OMEGA_DONGLE
config ZMK_KEYBOARD_NAME
    default "Delta Omega"
config ZMK_SPLIT_ROLE_CENTRAL
    default y
config ZMK_SPLIT
    default y
config ZMK_SPLIT_BLE_CENTRAL_PERIPHERALS
    default 2
config BT_MAX_CONN
    default 7
config BT_MAX_PAIRED
    default 7
config ZMK_SPLIT_BLE_CENTRAL_BATTERY_LEVEL_FETCHING
    default y
config ZMK_SPLIT_BLE_CENTRAL_BATTERY_LEVEL_PROXY
    default y
config ZMK_USB_BOOT
    default y
config ZMK_SLEEP
    default n
endif

if SHIELD_DELTA_OMEGA_LEFT_CENTRAL
config ZMK_KEYBOARD_NAME
    default "Delta Omega"
config ZMK_SPLIT_ROLE_CENTRAL
    default y
config ZMK_SPLIT_BLE_CENTRAL_PERIPHERALS
    default 1
config ZMK_SPLIT
    default y
config ZMK_SPLIT_BLE_CENTRAL_BATTERY_LEVEL_FETCHING
    default y
config ZMK_SPLIT_BLE_CENTRAL_BATTERY_LEVEL_PROXY
    default y
endif

if SHIELD_DELTA_OMEGA_LEFT
config ZMK_KEYBOARD_NAME
    default "Delta Omega L"
config ZMK_SPLIT
    default y
endif

if SHIELD_DELTA_OMEGA_RIGHT
config ZMK_KEYBOARD_NAME
    default "Delta Omega R"
config ZMK_SPLIT
    default y
endif

if SHIELD_DELTA_OMEGA_RESET
config ZMK_SETTINGS_RESET_ON_START
    default y
config ZMK_BLE_CLEAR_BONDS_ON_START
    default y
endif
```

## config/boards/shields/delta_omega/Kconfig.shield
```kconfig
config SHIELD_DELTA_OMEGA_LEFT
    def_bool $(shields_list_contains,delta_omega_left)

config SHIELD_DELTA_OMEGA_LEFT_CENTRAL
    def_bool $(shields_list_contains,delta_omega_left_central)

config SHIELD_DELTA_OMEGA_RIGHT
    def_bool $(shields_list_contains,delta_omega_right)

config SHIELD_DELTA_OMEGA_DONGLE
    def_bool $(shields_list_contains,delta_omega_dongle)

config SHIELD_DELTA_OMEGA_RESET
    def_bool $(shields_list_contains,delta_omega_reset)
```
